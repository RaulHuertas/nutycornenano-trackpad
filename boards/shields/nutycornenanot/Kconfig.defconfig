## boards/shields/nutycornenanot/Kconfig.defconfig
```kconfig
if SHIELD_NUTYCORNENANOT
# Name must be less than 16 characters long!
config ZMK_KEYBOARD_NAME
    default "NutyCorneNanoT"

config ZMK_POINTING
    default y

config I2C
    default y

config ZMK_POINTING_SMOOTH_SCROLLING
    default y

endif
```

## boards/shields/nutycornenanot/Kconfig.shield
```kconfig
config SHIELD_NUTYCORNENANOT
    def_bool $(shields_list_contains,nutycornenanot)
```
